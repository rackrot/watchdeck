## firmware/main/Kconfig.projbuild
```kconfig
menu "watchdeck"

    config WATCHDECK_WIFI_SSID
        string "Wi-Fi SSID"
        default ""
        help
            Used when /sdcard/wifi.txt is absent. Put real values in the
            gitignored sdkconfig.defaults.local. Empty means do not connect.

    config WATCHDECK_WIFI_PASSWORD
        string "Wi-Fi password"
        default ""

    config WATCHDECK_TEST_CRASH
        bool "Crash 30 s after the first welcome (manual checks only)"
        default n
        help
            Dereferences NULL 30 s after the first welcome from the daemon, to
            exercise the coredump and report path. Leave off in real builds.

    config WATCHDECK_TEST_CARD
        bool "Run the TF card write self-test at boot (manual checks only)"
        default n
        help
            Writes watchdeck/selftest.cfg and 20 write-once watchdeck/<8hex>.bin
            files on the TF card at every boot, reads each back, logs the
            result, then shares the card over USB after 30 s. Back up the card
            before flashing it. Leave off in real builds.

endmenu
```
